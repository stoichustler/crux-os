## roux/users/examples/mml_parser/Kconfig
```kconfig
#
# For a description of the syntax of this configuration file,
# see the file kconfig-language.txt in the ROUX tools repository.
#

config EXAMPLES_MMLPARSER
	tristate "mml_parser example"
	default n
	---help---
		Enable the mml_parser example
```

## roux/users/examples/stepper/Kconfig
```kconfig
#
# For a description of the syntax of this configuration file,
# see the file kconfig-language.txt in the ROUX tools repository.
#

config EXAMPLES_STEPPER
	tristate "Stepper controller test"
	default n
	---help---
		Enable the stepper controller test
```
