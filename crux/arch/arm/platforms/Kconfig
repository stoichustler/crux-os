## crux/arch/arm/platforms/Kconfig
```kconfig
choice
	prompt "Platform Support" if MMU
	default ALL_PLAT
	help
	  Choose which hardware platform to enable in crux.

	  If unsure, choose ALL_PLAT.

config ALL_PLAT
	bool "All Platforms"
	help
	  Enable support for all available hardware platforms. It doesn't
	  automatically select any of the related drivers.

config QEMU
	bool "QEMU aarch virt machine support"
	depends on ARM_64
	select GICV3
	select HAS_PL011
	help
	  Enable all the required drivers for QEMU aarch64 virt emulated
	  machine.

config RK3566
	bool "Rockchip rk3566 support"
	depends on ARM_64
	select GICV3
	select ARM_SMMU
	select HAS_NS16550
	select HAS_ITS
	help
	  Enable all the required drivers for Rockchip rk356x SoC.

config RK3588
	bool "Rockchip rk3588 support"
	depends on ARM_64
	select GICV3
	select ARM_SMMU
	select HAS_NS16550
	select HAS_ITS
	help
	  Enable all the required drivers for Rockchip rk3588 SoC.

config RCAR3
	bool "Renesas R-Car Gen3 support"
	depends on ARM_64
	select HAS_SCIF
	select IPMMU_VMSA
	help
	  Enable support for Renesas R-Car Generation 3 SoCs (H3, M3, etc.).
	  Includes all required drivers and platform-specific features.

config RCAR4
	bool "Renesas R-Car Gen4 support"
	depends on ARM_64
	select HAS_SCIF
	select HAS_ITS
	select IPMMU_VMSA
	help
	  Enable support for Renesas R-Car Generation 4 SoCs (V4H, V4M, etc.).
	  Includes all required drivers and platform-specific features.

config MPSOC
	bool "Xilinx Ultrascale+ MPSoC support"
	depends on ARM_64
	select HAS_CADENCE_UART
	select ARM_SMMU
	help
	  Enable all the required drivers for Xilinx Ultrascale+ MPSoC

config S32G3
	bool "NXP S32G3 Processors support"
	depends on ARM_64
	select HAS_LINFLEX
	select SCMI_SMC
	help
	  Enable all the required drivers for NXP S32G3 Processors Family

config NO_PLAT
	bool "No Platforms"
	help
	  Do not enable specific support for any platform.

endchoice

config ALL64_PLAT
	bool
	default (ALL_PLAT && ARM_64)

config ALL32_PLAT
	bool
	default (ALL_PLAT && ARM_32)

config MPSOC_PLATFORM
	bool
	default (ALL64_PLAT || MPSOC)

config PLAT_OPT
	string "Platform Option"
	default "QEMU" if QEMU
	default "RK3566" if RK3566
	default "RK3588" if RK3588
	default "RCAR3" if RCAR3
	default "RCAR4" if RCAR4
	default "MPSOC" if MPSOC
	default "S32G3" if S32G3
	default "ALL"
```

## crux/drivers/video/Kconfig
```kconfig
config VIDEO
	bool

config VGA
	bool "VGA support"
	select VIDEO
	depends on X86
	default y if !PV_SHIM_EXCLUSIVE
	help
	  Enable VGA output for the crux hypervisor.

	  If unsure, say Y.
```

## roux/arch/arm64/src/crux/Kconfig
```kconfig
#
# For a description of the syntax of this configuration file,
# see the file kconfig-language.txt in the ROUX tools repository.
#

if ARCH_CHIP_CRUX

menu "CRUX Virt Chip Selection"

choice
	prompt "CRUX Core Configuration"
	default ARCH_CHIP_CRUX_A53

config ARCH_CHIP_CRUX_A53
	bool "CRUX virtual Processor (cortex-a53)"
	select ARCH_HAVE_MULTICPU
	select ARMV8A_HAVE_GICv3
	select ARM64_HAVE_PSCI
	select ARCH_CORTEX_A53

config ARCH_CHIP_CRUX_A55
	bool "CRUX virtual Processor (cortex-a57)"
	select ARCH_HAVE_MULTICPU
	select ARMV8A_HAVE_GICv3
	select ARM64_HAVE_PSCI
	select ARCH_CORTEX_A55

config ARCH_CHIP_CRUX_UNKNOWN
	bool "CRUX virtual Processor (unknown CPU)"
	select ARCH_HAVE_MULTICPU
	select ARMV8A_HAVE_GICv3
	select ARM64_HAVE_PSCI
	select ARCH_CPU_UNKNOWN

endchoice # CRUX Chip Selection

config ARCH_CHIP_CRUX_WITH_HV
	bool "CRUX with hypervisor"
	default n

endmenu # "CRUX Chip Selection"

endif # ARCH_CHIP_CRUX
```

## roux/arch/arm64/src/rk356x/Kconfig
```kconfig
#
# For a description of the syntax of this configuration file,
# see the file kconfig-language.txt in the ROUX tools repository.
#

if ARCH_CHIP_RK356X

menu "RK356X Virt Chip Selection"

choice
	prompt "RK356X Core Configuration"
	default ARCH_CHIP_RK356X_A53

config ARCH_CHIP_RK356X_A53
	bool "RK356X virtual Processor (cortex-a53)"
	select ARCH_HAVE_MULTICPU
	select ARMV8A_HAVE_GICv3
	select ARM64_HAVE_PSCI
	select ARCH_CORTEX_A53

endchoice # RK356X Chip Selection

endmenu # "RK356X Chip Selection"

endif # ARCH_CHIP_RK356X
```
