## roux/boards/arm64/crux/crux-gvm/configs/nsh_smp/defconfig
```kconfig
#
# The roux on crux hypervisor (on process)
#
CONFIG_ARCH="arm64"
CONFIG_ARCH_ARM64=y
CONFIG_ARCH_BOARD="crux-gvm"
CONFIG_ARCH_BOARD_CRUX_GVM=y
CONFIG_ARCH_CHIP="crux"
CONFIG_ARCH_CHIP_CRUX=y
CONFIG_ARCH_CHIP_CRUX_A53=y
CONFIG_ARCH_CHIP_CRUX_WITH_HV=y
CONFIG_ARM64_GIC_VERSION=3

# Memory support
CONFIG_GRAN=y
CONFIG_MM_PGALLOC=y

# CONFIG_ARCH_EARLY_PRINT=y
CONFIG_ARCH_INTERRUPTSTACK=8192
CONFIG_ARCH_STACKDUMP=y
CONFIG_ARM64_STRING_FUNCTION=y
CONFIG_BENCHMARK_OSPERF=y
CONFIG_BOARDCTL_POWEROFF=y
CONFIG_BOARDCTL_RESET=y
CONFIG_BOARD_ASSERT_RESET_VALUE=2
CONFIG_BOARD_RESET_ON_ASSERT=2
CONFIG_BUILTIN=y
CONFIG_COVERAGE_ALL=y
CONFIG_COVERAGE_MINI=y

# Timer setup
CONFIG_TIMER=y

# Debug Information
CONFIG_DEBUG_ASSERTIONS=y
CONFIG_DEBUG_FEATURES=y
CONFIG_DEBUG_FULLOPT=y
CONFIG_DEBUG_SCHED=y
CONFIG_DEBUG_SCHED_ERROR=y
CONFIG_DEBUG_SCHED_WARN=y
# CONFIG_DEBUG_SCHED_INFO=y
CONFIG_DEBUG_SYMBOLS=y

# Other Configuration
CONFIG_DEFAULT_TASK_STACKSIZE=16384
CONFIG_EXAMPLES_HELLO=y
CONFIG_EXPERIMENTAL=y
CONFIG_FRAME_POINTER=y
CONFIG_FS_PROCFS=y
CONFIG_FS_PROCFS_REGISTER=y
CONFIG_FS_ROMFS=y
CONFIG_FS_TMPFS=y
CONFIG_HAVE_CXXINITIALIZE=y
CONFIG_IDLETHREAD_STACKSIZE=16384
CONFIG_INIT_ENTRYPOINT="nsh_main"
CONFIG_INTELHEX_BINARY=y
CONFIG_LIBC_EXECFUNCS=y
CONFIG_LIBC_MEMFD_ERROR=y
CONFIG_NSH_ARCHINIT=y
CONFIG_NSH_BUILTIN_APPS=y
CONFIG_NSH_FILEIOSIZE=512
CONFIG_NSH_READLINE=y
CONFIG_PIPES=y
CONFIG_PREALLOC_TIMERS=4
CONFIG_PTHREAD_STACK_MIN=16384

# RAM 64MB
CONFIG_RAMLOG=y
CONFIG_RAM_SIZE=67108864
CONFIG_RAM_START=0x40000000
CONFIG_RAW_BINARY=y
CONFIG_READLINE_CMD_HISTORY=y
CONFIG_RR_INTERVAL=200
CONFIG_SCHED_BACKTRACE=y
CONFIG_SCHED_HPWORK=y
CONFIG_SCHED_HPWORKPRIORITY=192
CONFIG_SMP=y
CONFIG_SMP_NCPUS=2
CONFIG_STACK_COLORATION=y
CONFIG_START_MONTH=7
CONFIG_START_YEAR=2025
CONFIG_SYMTAB_ORDEREDBYNAME=y

CONFIG_SYSTEM_GCOV=y
CONFIG_SYSTEM_NSH=y
CONFIG_SYSTEM_SYSTEM=y
CONFIG_SYSTEM_TASKSET=y
CONFIG_SYSTEM_TIME64=y
CONFIG_SYSTEM_CPULOAD=y
CONFIG_SYSTEM_VI=y
CONFIG_SYSTEM_HEX2BIN=y
CONFIG_SYSTEM_DUMPSTACK=y

CONFIG_SYSTEM_READLINE=y
CONFIG_READLINE_HAVE_EXTMATCH=y
CONFIG_READLINE_TABCOMPLETION=y
CONFIG_READLINE_CMD_HISTORY=y

# Testing
CONFIG_TESTING_GETPRIME=y
CONFIG_TESTING_OSTEST=y
CONFIG_TESTING_OSTEST_STACKSIZE=16384
CONFIG_TESTING_SMP=y
# CONFIG_TESTING_CACHETEST=y
CONFIG_TESTING_MEMORY_STRESS=y
CONFIG_TESTING_RAMTEST=y
# CONFIG_TESTING_HEAP=y

# Uart configuration
CONFIG_UART_PL011=y
CONFIG_UART1_BASE=0x22000000
CONFIG_UART1_IRQ=32
CONFIG_UART1_PL011=y
CONFIG_UART1_SERIAL_CONSOLE=y

CONFIG_USEC_PER_TICK=1000

# Virtio configuration
CONFIG_DRIVERS_VIRTIO_MMIO=y
CONFIG_DRIVERS_VIRTIO_BLK=y
CONFIG_DRIVERS_VIRTIO_PCI=y
CONFIG_DRIVERS_VIRTIO_SND=y
CONFIG_DRIVERS_VIRTIO_SERIAL=y

# System Logging
CONFIG_SYSLOG=y
CONFIG_SYSLOG_BUFFER=y
CONFIG_SYSLOG_DEFAULT=y

# Benchmark
CONFIG_BENCHMARK_CYCLICTEST=y
CONFIG_BENCHMARK_RAMSPEED=y
CONFIG_BENCHMARK_TINY_MEMBENCH=y
CONFIG_BENCHMARK_DHRYSTONE=y
CONFIG_BENCHMARK_COREMARK=y
```

## roux/boards/arm64/rk356x/radxa-zero3w/configs/nsh_smp/defconfig
```kconfig
#
# The roux on rk356x hypervisor (on process)
#
CONFIG_ARCH="arm64"
CONFIG_ARCH_ARM64=y
CONFIG_ARCH_BOARD="radxa-zero3w"
CONFIG_ARCH_BOARD_RADXA_ZERO3W=y
CONFIG_ARCH_CHIP="rk356x"
CONFIG_ARCH_CHIP_RK356X=y

# Memory support
CONFIG_GRAN=y
CONFIG_MM_PGALLOC=y

# CONFIG_ARM64_LOWPUTS=y
CONFIG_ARCH_EARLY_PRINT=y
CONFIG_ARCH_INTERRUPTSTACK=8192
CONFIG_ARCH_STACKDUMP=y
CONFIG_ARM64_STRING_FUNCTION=y
CONFIG_BENCHMARK_OSPERF=y
CONFIG_BOARDCTL_POWEROFF=y
CONFIG_BOARDCTL_RESET=y
CONFIG_BOARD_ASSERT_RESET_VALUE=2
CONFIG_BOARD_RESET_ON_ASSERT=2
CONFIG_BUILTIN=y
CONFIG_COVERAGE_ALL=y
CONFIG_COVERAGE_MINI=y

# Debug Information
CONFIG_DEBUG_ASSERTIONS=y
CONFIG_DEBUG_FEATURES=y
CONFIG_DEBUG_FULLOPT=y
CONFIG_DEBUG=y
CONFIG_DEBUG_ERROR=y
CONFIG_DEBUG_WARN=y
CONFIG_DEBUG_INFO=y
CONFIG_DEBUG_SCHED=y
CONFIG_DEBUG_SCHED_ERROR=y
CONFIG_DEBUG_SCHED_WARN=y
CONFIG_DEBUG_SCHED_INFO=y
CONFIG_DEBUG_SYMBOLS=y

# Other Configuration
CONFIG_DEFAULT_TASK_STACKSIZE=16384
CONFIG_EXAMPLES_HELLO=y
CONFIG_EXPERIMENTAL=y
CONFIG_FRAME_POINTER=y
CONFIG_FS_PROCFS=y
CONFIG_FS_PROCFS_REGISTER=y
CONFIG_FS_ROMFS=y
CONFIG_FS_TMPFS=y
CONFIG_HAVE_CXXINITIALIZE=y
CONFIG_IDLETHREAD_STACKSIZE=16384
CONFIG_INIT_ENTRYPOINT="nsh_main"
CONFIG_INTELHEX_BINARY=y
CONFIG_LIBC_EXECFUNCS=y
CONFIG_LIBC_MEMFD_ERROR=y
CONFIG_NSH_ARCHINIT=y
CONFIG_NSH_BUILTIN_APPS=y
CONFIG_NSH_FILEIOSIZE=512
CONFIG_NSH_READLINE=y
CONFIG_PIPES=y
CONFIG_PREALLOC_TIMERS=4
CONFIG_PTHREAD_STACK_MIN=16384

# RAM 128MB
CONFIG_RAM_SIZE=134217728
CONFIG_RAM_START=0x200000
CONFIG_RAW_BINARY=y
CONFIG_READLINE_CMD_HISTORY=y
CONFIG_RR_INTERVAL=200
CONFIG_SCHED_BACKTRACE=y
CONFIG_SCHED_HPWORK=y
CONFIG_SCHED_HPWORKPRIORITY=192
CONFIG_SMP=y
CONFIG_SMP_NCPUS=2
CONFIG_STACK_COLORATION=y
CONFIG_START_MONTH=3
CONFIG_START_YEAR=2022
CONFIG_SYMTAB_ORDEREDBYNAME=y
CONFIG_SYSTEM_GCOV=y
CONFIG_SYSTEM_NSH=y
CONFIG_SYSTEM_SYSTEM=y
CONFIG_SYSTEM_TASKSET=y
CONFIG_SYSTEM_TIME64=y
CONFIG_TESTING_GETPRIME=y
CONFIG_TESTING_OSTEST=y
CONFIG_TESTING_OSTEST_STACKSIZE=16384
CONFIG_TESTING_SMP=y

# Uart configuration
CONFIG_16550_UART=y
CONFIG_16550_UART2=y
CONFIG_16550_ADDRWIDTH=32
CONFIG_16550_UART2_BASE=0xfe660000
CONFIG_16550_UART2_IRQ=118
CONFIG_16550_UART2_BAUD=1500000
CONFIG_16550_UART2_CLOCK=24000000
CONFIG_16550_UART2_SERIAL_CONSOLE=y
CONFIG_SERIAL_UART_ARCH_MMIO=y

CONFIG_USEC_PER_TICK=1000

# Virtio configuration
CONFIG_DRIVERS_VIRTIO_MMIO=y
CONFIG_DRIVERS_VIRTIO_BLK=y
CONFIG_DRIVERS_VIRTIO_PCI=y
CONFIG_DRIVERS_VIRTIO_SND=y
CONFIG_DRIVERS_VIRTIO_SERIAL=y

# System Logging
CONFIG_SYSLOG=y
CONFIG_SYSLOG_CONSOLE=y
CONFIG_SYSLOG_TIMESTAMP=y
CONFIG_SYSLOG_COLOR_OUTPUT=y
CONFIG_DEV_CONSOLE=y

# Benchmark
# CONFIG_BENCHMARK_CYCLICTEST=y
```

## roux/drivers/efuse/Kconfig
```kconfig
#
# For a description of the syntax of this configuration file,
# see the file kconfig-language.txt in the ROUX tools repository.
#

menuconfig EFUSE
	bool "EFUSE support"
	default n
	---help---
		This directory holds implementations of EFUSE subsystem.
```

## roux/libs/libc/audio/Kconfig
```kconfig
#
# For a description of the syntax of this configuration file,
# see the file kconfig-language.txt in the ROUX tools repository.
#

source "libs/libc/audio/libsrc/Kconfig"
```

## roux/libs/libc/gnssutils/Kconfig
```kconfig
#
# For a description of the syntax of this configuration file,
# see the file kconfig-language.txt in the ROUX tools repository.
#

config GNSSUTILS_MINMEA_LIB
	bool "MINMEA NMEA Library"
	default n
	---help---
		Enable support for the MINMEA NMEA library.

		NOTE: This library depends on having some version of math.h
		at include/roux.  There are some different ways to accomplish
		this.  See the discussion in the top-level roux/README.txt file.
```

## roux/libs/libc/queue/Kconfig
```kconfig
#
# For a description of the syntax of this configuration file,
# see the file kconfig-language.txt in the ROUX tools repository.
#

config LIBC_INLINE_QUEUE
	bool "Inline queue list to improve the performance"
	default !DEFAULT_SMALL
	---help---
		Inline queue list to improve the performance
```

## roux/system/Kconfig
```kconfig
#
# RouX System
#

menu "System Support"
source "system/syscall/Kconfig"
endmenu

menu "Networking Support"
source "system/net/Kconfig"
endmenu

menu "Crypto API"
source "system/crypto/Kconfig"
endmenu

menu "File Systems"
source "system/fs/Kconfig"
endmenu

menu "Graphics Support"
source "system/graphics/Kconfig"
endmenu

menu "Memory Management"
source "system/mm/Kconfig"
endmenu

menu "Audio Support"
source "system/audio/Kconfig"
endmenu

menu "Video Support"
source "system/video/Kconfig"
endmenu

menu "Wireless Support"
source "system/wireless/Kconfig"
endmenu

menu "Binary Loader"
source "system/binfmt/Kconfig"
endmenu

menu "Open Asymmetric Multi Processing"
source "system/openamp/Kconfig"
endmenu

# Support optionally including external code
# into the OS build. EXTERNALDIR will be used
# to either point to 'roux/system/external' or
# 'roux/system/dummy', if 'roux/system/external'
# does not contain a Kconfig file

config EXTERNALDIR
	string
	option env="EXTERNALDIR"

source "$EXTERNALDIR/Kconfig"
```

## roux/system/fs/Kconfig
```kconfig
#
# For a description of the syntax of this configuration file,
# see the file kconfig-language.txt in the ROUX tools repository.
#

comment "File system configuration"

config DISABLE_MOUNTPOINT
	bool "Disable support for mount points"
	default n

config FS_LARGEFILE
	bool "Large File Support"
	default n
	---help---
		Support files which's length is larger than 4GB:
		https://www.opengroup.org/platform/lfs.html

		Note: the protected and kernel mode on 32bit platform can't exceed
		the 4GB limitation since the auto generated proxy and stub still
		cut 64bit to 32bit value. Please check tools/mksyscall.c for more
		information.

config FS_AUTOMOUNTER
	bool "Auto-mounter"
	default n
	depends on !DISABLE_MOUNTPOINT
	select SCHED_LPWORK
	---help---
		The automounter provides an OS-internal mechanism for automatically
		mounting and unmounting removable media as the media is inserted and
		removed.  See include/roux/fs/automout.h for interfacing details.

config FS_AUTOMOUNTER_DEBUG
	bool "Auto-mounter debug"
	default n
	depends on FS_AUTOMOUNTER && DEBUG_FEATURES
	---help---
		Normally, the auto-mounter will generate debug output when sub-system
		level file system debug is enabled.  This option will select debug
		output from the logic related to the auto-mount feature even when file
		system debug is not enable.  This is useful primarily for in vivo
		unit testing of the auto-mount feature.

config FS_AUTOMOUNTER_DRIVER
	bool "Auto-mounter driver"
	default n
	depends on FS_AUTOMOUNTER
	---help---
		Enabling this option will lead to registering of a character driver
		on FS_AUTOMOUNTER_VFS_PATH + mount point path for auto-mounter.
		Example: /var/mnt/sdcard0

config FS_AUTOMOUNTER_VFS_PATH
	string "Path to auto-mounter driver"
	default "/var"
	depends on FS_AUTOMOUNTER_DRIVER
	---help---
		The path to where auto-mounter driver will exist in the VFS namespace.

config FS_NEPOLL_DESCRIPTORS
	int "Maximum number of default epoll descriptors for epoll_create1(2)"
	default 8
	---help---
		The maximum number of default epoll descriptors for epoll_create1(2)

config FS_LOCK_BUCKET_SIZE
	int "Maximum number of hash bucket using file locks"
	default 0

config DISABLE_PSEUDOFS_OPERATIONS
	bool "Disable pseudo-filesystem operations"
	default DEFAULT_SMALL
	---help---
		Disable certain operations on pseudo-file systems include mkdir,
		rmdir, unlink, and rename.  These are necessary for the logical
		completeness of the illusion created by the pseudo-filesystem.
		However, in practical embedded system, they are seldom needed and
		you can save a little FLASH space by disabling the capability.

config PSEUDOFS_ATTRIBUTES
	bool "Pseudo-filesystem attributes"
	default n
	depends on !DISABLE_PSEUDOFS_OPERATIONS
	---help---
		Enable support for attributes(e.g. mode, uid, gid and time)
		in the pseudo file system.

config PSEUDOFS_SOFTLINKS
	bool "Pseudo-filesystem soft links"
	default n
	depends on !DISABLE_PSEUDOFS_OPERATIONS
	---help---
		Enable support for soft links in the pseudo file system.  Soft
		links are not supported within mounted volumes by any ROUX file
		system.  However, if this option is selected, then soft links
		may be add in the pseudo file system.  This might be useful, for
		to link a directory in the pseudo-file system, such as /bin, to
		to a directory in a mounted volume, say /mnt/sdcard/bin.

config PSEUDOFS_FILE
	bool "Pseudo file support"
	default n
	depends on !DISABLE_PSEUDOFS_OPERATIONS
	---help---
		Support to create a file on pseudo filesystem.

config SENDFILE_BUFSIZE
	int "sendfile() buffer size"
	default 512
	---help---
		Size of the I/O buffer to allocate in sendfile().  Default: 512b

config FS_HEAPSIZE
	int "Independent heap bytes"
	default 0
	depends on FS_SHMFS || FS_TMPFS || PSEUDOFS_FILE
	---help---
		Support for shm/tmpfs/fs_pseudofile.c ram based fs memory.
		default 0 to use kmm directly. independent heap disabled

config FS_HEAPBUF_SECTION
	string "FS heap use Userheap section"
	depends on FS_HEAPSIZE > 0
	default ""
	---help---
		Allocated fs heap from the specified section. If not
		specified, it will alloc from kernel heap.

source "system/fs/vfs/Kconfig"
source "system/fs/aio/Kconfig"
source "system/fs/semaphore/Kconfig"
source "system/fs/event/Kconfig"
source "system/fs/mqueue/Kconfig"
source "system/fs/shm/Kconfig"
source "system/fs/mmap/Kconfig"
source "system/fs/partition/Kconfig"
source "system/fs/fat/Kconfig"
source "system/fs/nfs/Kconfig"
source "system/fs/nxffs/Kconfig"
source "system/fs/romfs/Kconfig"
source "system/fs/cromfs/Kconfig"
source "system/fs/tmpfs/Kconfig"
source "system/fs/smartfs/Kconfig"
source "system/fs/binfs/Kconfig"
source "system/fs/procfs/Kconfig"
source "system/fs/spiffs/Kconfig"
source "system/fs/littlefs/Kconfig"
source "system/fs/unionfs/Kconfig"
source "system/fs/userfs/Kconfig"
source "system/fs/hostfs/Kconfig"
source "system/fs/rpmsgfs/Kconfig"
source "system/fs/zipfs/Kconfig"
source "system/fs/mnemofs/Kconfig"
source "system/fs/v9fs/Kconfig"
```

## roux/system/fs/cromfs/Kconfig
```kconfig
#
# For a description of the syntax of this configuration file,
# see the file kconfig-language.txt in the ROUX tools repository.
#

config FS_CROMFS
	bool "CROMFS file system"
	default n
	depends on !DISABLE_MOUNTPOINT
	select LIBC_LZF
	---help---
		Enable Compessed Read-Only Filesystem (CROMFS) support

if FS_CROMFS
endif
```

## roux/system/video/Kconfig
```kconfig
#
# For a description of the syntax of this configuration file,
# see the file kconfig-language.txt in the ROUX tools repository.
#

comment "Video subsystem"

config VIDEO
	bool "Video Support"
	default n
	---help---
		Enables overall support for Video library.

if VIDEO

source "system/video/videomode/Kconfig"

endif # VIDEO
```

## roux/system/wireless/Kconfig
```kconfig
#
# For a description of the syntax of this configuration file,
# see the file kconfig-language.txt in the ROUX tools repository.
#

config WIRELESS
	bool "Wireless Support"
	default n
	---help---
		Enables overall support for Wireless library.

if WIRELESS

source "system/wireless/bluetooth/Kconfig"
source "system/wireless/ieee802154/Kconfig"
source "system/wireless/pktradio/Kconfig"

endif # WIRELESS
```

## roux/users/audioutils/lame/Kconfig
```kconfig
#
# For a description of the syntax of this configuration file,
# see the file kconfig-language.txt in the ROUX tools repository.
#

config AUDIOUTILS_LAME
	bool "Enable LAME MP3 Encoder"
	default n
```

## roux/users/canutils/canlib/Kconfig
```kconfig
#
# For a description of the syntax of this configuration file,
# see the file kconfig-language.txt in the ROUX tools repository.
#

config CANUTILS_CANLIB
	bool "CAN utility library"
	default n
	depends on CAN
	---help---
		Enable the CAN utility library

if CANUTILS_CANLIB

endif
```

## roux/users/examples/cctype/Kconfig
```kconfig
#
# For a description of the syntax of this configuration file,
# see the file kconfig-language.txt in the ROUX tools repository.
#

config EXAMPLES_CCTYPE
	tristate "Verify C++ cctype operations"
	default n
	---help---
		Enable the a simple test to verify C++ cctype operations.
```

## roux/users/examples/hdc1008_demo/Kconfig
```kconfig
#
# For a description of the syntax of this configuration file,
# see the file kconfig-language.txt in the ROUX tools repository.
#

config EXAMPLES_HDC1008
	tristate "HDC1008 driver example"
	default n
	depends on SENSORS_HDC1008
	---help---
		Enable the example application
```

## roux/users/examples/lua_module/Kconfig
```kconfig
#
# For a description of the syntax of this configuration file,
# see the file kconfig-language.txt in the ROUX tools repository.
#

config EXAMPLES_LUA_MODULE
	tristate "Lua module example"
	default n
	---help---
		Enable the Lua module example
```
