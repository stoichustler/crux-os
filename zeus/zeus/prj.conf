## CMakeLists.txt
```
# SPDX-License-Identifier: Apache-2.0

# python libs requirements:
# [1] pip install packaging pyelftools pykwalify pyyaml

cmake_minimum_required(VERSION 3.20.0)

#######################################################
# NOTE: enssential setup for building zephyr with CMake
# only:

set(ZEPHYR_TOOLCHAIN_VARIANT cross-compile)

set(BUILD_VERSION 1.0.0)
#######################################################
# NOTE: target board

if (BOARD STREQUAL "radxa_zero3w/rk3568/xen_dom0")
  if(NOT xen_dom0 IN_LIST SNIPPET)
    set(SNIPPET xen_dom0 ${SNIPPET} CACHE STRING "" FORCE)
  endif()
endif()

if (BOARD STREQUAL "roc_rk3588_rt/rk3588/xen_dom0")
  if(NOT xen_dom0 IN_LIST SNIPPET)
    set(SNIPPET xen_dom0 ${SNIPPET} CACHE STRING "" FORCE)
  endif()
endif()

if (BOARD STREQUAL "qemu_cortex_a53/qemu_cortex_a53")
  if(NOT xen_dom0 IN_LIST SNIPPET)
    set(SNIPPET xen_dom0 ${SNIPPET} CACHE STRING "" FORCE)
  endif()
endif()

find_package(Zephyr REQUIRED HINTS $ENV{ZEPHYR_BASE})

project(zeus)

# User application
target_sources(app PRIVATE src/zeus.c)

zephyr_sources_ifdef(CONFIG_XEN_DOM0 src/xcmd.c)

# Latency measure sources
FILE(GLOB latency_sources src/latency/*.c)
zephyr_sources_ifdef(CONFIG_TEST ${latency_sources})

zephyr_sources(
	src/coremark/core_main.c
	src/coremark/core_matrix.c
	src/coremark/core_state.c
	src/coremark/core_util.c
	src/coremark/core_list_join.c
	src/coremark/core_portme.c
	src/coremark/core_shcmd.c
)


#######################################################
```

## prj.conf
```kconfig
# enable kernel shell
CONFIG_SHELL=y
CONFIG_SHELL_GETOPT=y
# CONFIG_SHELL_BACKEND_DUMMY=y
CONFIG_SHELL_BACKEND_SERIAL=y
CONFIG_SHELL_CMD_BUFF_SIZE=90
CONFIG_SHELL_PRINTF_BUFF_SIZE=15
CONFIG_SHELL_PROMPT_UART="zeus $ "

# enable logging
#
#
# 4 -> step-through debug infos
CONFIG_LOG=y
CONFIG_LOG_PRINTK=y
CONFIG_LOG_DEFAULT_LEVEL=3
CONFIG_LOG_BUFFER_SIZE=4096

#enable output disassembly
CONFIG_OUTPUT_DISASSEMBLY=y
CONFIG_OUTPUT_DISASSEMBLY_WITH_SOURCE=y

# enable boottime debug
CONFIG_DEBUG=y

# enable os opts
CONFIG_REBOOT=y

# enable safe exception
CONFIG_ARM64_SAFE_EXCEPTION_STACK=y

# enable file system
CONFIG_FILE_SYSTEM=y
CONFIG_FILE_SYSTEM_SHELL=y

# ISR
# CONFIG_ISR_TABLE_SHELL=y

# stats
CONFIG_STATS=y
CONFIG_STATS_SHELL=y

# symbol table
CONFIG_SYMTAB=y
CONFIG_SYMTAB_SHELL=y

# Heap Memory Allocation (8Mb)
# For k_malloc use case (issue booting for Xen)
# CONFIG_HEAP_MEM_POOL_SIZE=8388608
# CONFIG_SYS_HEAP_RUNTIME_STATS=y

# CONFIG_PROFILING=y
# CONFIG_PROFILING_PERF=y
# CONFIG_PROFILING_PERF_BUFFER_SIZE=

# Network
CONFIG_NETWORKING=y
CONFIG_NET_HOSTNAME_ENABLE=y
CONFIG_TEST_RANDOM_GENERATOR=y
CONFIG_TIMER_RANDOM_GENERATOR=y

# Power Management
# CONFIG_PM=y
# CONFIG_PM_DEVICE=y

# CONFIG_TRACING=y
# CONFIG_PERCEPIO_TRACERECORDER=y
# CONFIG_PERCEPIO_TRC_START_MODE_START=y
# CONFIG_PERCEPIO_TRC_CFG_STREAM_PORT_RINGBUFFER=y
# CONFIG_PERCEPIO_TRC_CFG_STREAM_PORT_RINGBUFFER_SIZE=
#

#
CONFIG_EARLY_CONSOLE=y

# Benchmark latency
# CONFIG_TEST=y
# CONFIG_SYS_CLOCK_TICKS_PER_SEC=1
# CONFIG_IRQ_OFFLOAD=y
# CONFIG_BT=n
# CONFIG_FORCE_NO_ASSERT=y
# CONFIG_TEST_HW_STACK_PROTECTION=n
# CONFIG_HW_STACK_PROTECTION=n
# CONFIG_COVERAGE=n
# CONFIG_PM=n
# CONFIG_TIMING_FUNCTIONS=y
# CONFIG_HEAP_MEM_POOL_SIZE=2048
# CONFIG_APPLICATION_DEFINED_SYSCALL=y
# CONFIG_TIMESLICING=n
# CONFIG_EVENTS=y

# Thread analyzer
CONFIG_THREAD_ANALYZER=y
# CONFIG_THREAD_ANALYZER_USE_LOG=y
# CONFIG_THREAD_ANALYZER_AUTO=y

# Core dump
CONFIG_COREDUMP_DEVICE=y
CONFIG_DEBUG_COREDUMP=y
CONFIG_DEBUG_COREDUMP_SHELL=y
CONFIG_DEBUG_COREDUMP_BACKEND_LOGGING=y
CONFIG_DEBUG_COREDUMP_MEMORY_DUMP_MIN=y
CONFIG_DEBUG_COREDUMP_MEMORY_DUMP_LINKER_RAM=y

# RTIO
CONFIG_RTIO=y

# IPC service
CONFIG_IPC_SERVICE=y

CONFIG_TIMING_FUNCTIONS=y

# HW Info
CONFIG_HWINFO=y
CONFIG_HWINFO_SHELL=y

# Virtio
CONFIG_VIRTIO=y

# Littlefs

# Network
# CONFIG_REQUIRES_FULL_LIBC=y
CONFIG_NETWORKING=y
CONFIG_TEST_RANDOM_GENERATOR=y
CONFIG_MAIN_STACK_SIZE=5200
CONFIG_SHELL_STACK_SIZE=5200
CONFIG_NET_TX_STACK_SIZE=2048
CONFIG_NET_RX_STACK_SIZE=2048
CONFIG_NET_PKT_RX_COUNT=10
CONFIG_NET_PKT_TX_COUNT=10
CONFIG_NET_BUF_RX_COUNT=20
CONFIG_NET_BUF_TX_COUNT=20
CONFIG_NET_MAX_CONTEXTS=10
CONFIG_NET_DHCPV4=y
CONFIG_NET_IPV4=y
CONFIG_NET_IPV6=n
CONFIG_NET_TCP=y
CONFIG_NET_LOG=y
CONFIG_INIT_STACKS=y
CONFIG_NET_SHELL=y
CONFIG_NET_STATISTICS=y
CONFIG_NET_STATISTICS_PERIODIC_OUTPUT=n
CONFIG_WIFI=y
CONFIG_WIFI_LOG_LEVEL_ERR=y
# CONFIG_NET_L2_WIFI_SHELL=y
CONFIG_NET_MGMT_EVENT_QUEUE_TIMEOUT=5000
CONFIG_NET_MGMT_EVENT_QUEUE_SIZE=16
```

## src/xcmd.c
```c
/*
 * Copyright (c) 2025 HUSTLER
 *
 * SPDX-License-Identifier: Apache-2.0
 */

#include <zephyr/xen/generic.h>
#include <zephyr/xen/dom0/domctl.h>
#include <zephyr/xen/dom0/sysctl.h>
#include <zephyr/xen/dom0/version.h>
#include <zephyr/xen/public/xen.h>

#include <zephyr/shell/shell.h>
#include <zephyr/logging/log.h>
#include <stdlib.h>

LOG_MODULE_REGISTER(crux_cmds);

#define MAX_DOMAINS         (3)

static int crux_stats(const struct shell *sh, int argc, char **argv)
{
	uint32_t nr_dom, i, domid;
	int rc;
	xen_domctl_getdomaininfo_t doms_info[MAX_DOMAINS];
	struct xen_sysctl_physinfo phys_info;
	char extra_version[XEN_EXTRAVERSION_LEN];

	if ((rc = xen_sysctl_physinfo(&phys_info))) {
		shell_error(sh, "get crux physical infos failed: %d", rc);
		return -EINVAL;
	}

	nr_dom = xen_sysctl_getdomaininfo(doms_info, 0, MAX_DOMAINS);
	if (nr_dom > MAX_DOMAINS) {
		shell_error(sh, "get invalid vm number: %u > max(%u)",
			nr_dom, MAX_DOMAINS);
		return -EINVAL;
	}

	rc = xen_version_extraversion(extra_version, XEN_EXTRAVERSION_LEN);
	if (rc) {
		shell_error(sh, "get crux extra version failed\n");
		return -EINVAL;
	}

	/* get the version of crux */
	rc = xen_version();

	shell_print(sh,
	     "zeus as a vm-0 on crux\n\n"
	     "[<hyp>]\n"
	     "  version:                  %u.%u%s\n"
	     "  threads per core:         %u\n"
	     "  cores per socket:         %u\n"
	     "  nr cpus:                  %u\n"
	     "  nr nodes:                 %u\n"
	     "  cpu khz:                  %u\n"
	     "  capabilities:             0x%08x\n"
	     "  arch capabilities:        0x%08x\n"
	     "  total pages:              %llu\n"
	     "  free pages:               %llu\n"
	     "  scrub pages:              %llu\n"
	     "  outstanding pages:        %llu\n"
	     "  nr vms:                   %u",
	     (rc >> 16) & 0xFFFF, rc & 0xFFFF, extra_version,
	     phys_info.threads_per_core,
	     phys_info.cores_per_socket,
	     phys_info.nr_cpus,
	     phys_info.nr_nodes,
	     phys_info.cpu_khz,
	     phys_info.capabilities,
	     phys_info.arch_capabilities,
	     phys_info.total_pages,
	     phys_info.free_pages,
	     phys_info.scrub_pages,
	     phys_info.outstanding_pages,
	     nr_dom);

	for (i = 0; i < nr_dom; i++) {
		domid = i;

		shell_print(sh,
			"[<vm%u>]\n"
			"  flags:                    0x%08x\n"
			"  total pages:              %llu\n"
			"  maximum pages:            %llu\n"
			"  outstanding pages:        %llu\n"
			"  shared pages:             %llu\n"
			"  paged pages:              %llu\n"
			"  shared frames:            %llu\n"
			"  cpu time:                 %llu\n"
			"  online vcpus:             %u\n"
			"  guest address bits:       %u",
			domid,
			doms_info[domid].flags,
			doms_info[domid].tot_pages,
			doms_info[domid].max_pages,
			doms_info[domid].outstanding_pages,
			doms_info[domid].shr_pages,
			doms_info[domid].paged_pages,
			doms_info[domid].shared_info_frame,
			doms_info[domid].cpu_time,
			doms_info[domid].nr_online_vcpus,
			doms_info[domid].gpaddr_bits);
	}

	return 0;
}

SHELL_STATIC_SUBCMD_SET_CREATE(
	subcmd_box,
	SHELL_CMD_ARG(stats, NULL,
		      " Display crux vms stats\n",
		      crux_stats, 1, 0),
	SHELL_SUBCMD_SET_END);

SHELL_CMD_ARG_REGISTER(box,
	&subcmd_box,
	"crux hypervisor svm commands",
	NULL, 2, 0);
```

## src/zeus.c
```c
/*
 * Copyright (c) 2025 HUSTLER
 *
 * SPDX-License-Identifier: Apache-2.0
 */

#include <zephyr/kernel.h>
#include <zephyr/sys/printk.h>

#define SELF_BANNER                              \
"           _____     __  __\n"                  \
"  /\\/\\/\\/\\/ __  \\/\\ / _\\/__\\\n"         \
"  \\ - \\ \\ \\ \\/ // // _\\/  \\\n"           \
"   \\/\\/\\_/\\_/\\/ \\__\\__\\\\/\\/ zeus\n"   \
"\n"

void main(void)
{
#if defined(CONFIG_XEN_DOM0LESS)
	unsigned long count = 0;
#endif

	printk(SELF_BANNER);

	while (1) {
#if defined(CONFIG_XEN_DOM0LESS)
		printk("[%16lu] -- [activated] --\n", count++);
#endif
		k_sleep(K_SECONDS(60));
	}
}
```
