## up/configs/xenguest_arm64_dom0less_defconfig
```kconfig
#######################################################
#                      _____     __  __
#             /\/\/\/\/ __  \/\ / _\/__\
#             \ - \ \ \ \/ // // _\/  \
#              \/\/\_/\_/\/ \__\__\\/\/ @2025
#
#                  - Hustle Embedded -
#######################################################

CONFIG_ARM=y
CONFIG_TEXT_BASE=0x40080000
CONFIG_POSITION_INDEPENDENT=y
CONFIG_NR_DRAM_BANKS=1
CONFIG_SYS_LOAD_ADDR=0x40000000
CONFIG_SYS_BOOTM_LEN=0x800000
CONFIG_BOOTDELAY=10
#
CONFIG_SYS_MALLOC_LEN=0x2000000
CONFIG_SYS_MALLOC_F_LEN=0x400
# Console output buffer size
CONFIG_SYS_PBSIZE=1051

# PCI
CONFIG_DM_PCI_COMPAT=y
CONFIG_PCI_REGION_MULTI_ENTRY=y
CONFIG_PCIE_ECAM_GENERIC=y
CONFIG_PCI_INIT_R=y
CONFIG_SYS_PCI_64BIT=y
CONFIG_PCI=y

CONFIG_LOG=y
CONFIG_LOGLEVEL=9

# Todo
CONFIG_TARGET_XENGUEST_ARM64_DOM0LESS=y
CONFIG_DEFAULT_DEVICE_TREE="xenguest-arm64"
CONFIG_IDENT_STRING=" xenguest"

# Commands
CONFIG_CMD_GPT=y
CONFIG_CMD_EXT4=y
CONFIG_CMD_FAT=y
CONFIG_CMD_PCI=y
CONFIG_CMD_DHRYSTONE=y

# Virtios
CONFIG_VIRTIO_MMIO=y
CONFIG_VIRTIO_PCI=y
CONFIG_VIRTIO_NET=y
CONFIG_VIRTIO_BLK=y

# Debug Uart
CONFIG_PL011_SERIAL=y
CONFIG_CONS_INDEX=0
CONFIG_DEBUG_UART=y
CONFIG_DEBUG_UART_BASE=0x22000000
CONFIG_DEBUG_UART_CLOCK=0
CONFIG_DEBUG_UART_PL011=y
CONFIG_DEBUG_UART_SHIFT=2

#
CONFIG_CMD_MTDPARTS=y
CONFIG_MTD=y
CONFIG_DM_MTD=y
CONFIG_MTD_NOR_FLASH=y
CONFIG_FLASH_SHOW_PROGRESS=0
CONFIG_CFI_FLASH=y
CONFIG_CFI_FLASH_USE_WEAK_ACCESSORS=y
CONFIG_SYS_FLASH_USE_BUFFER_WRITE=y
CONFIG_FLASH_CFI_MTD=y
CONFIG_SYS_FLASH_CFI=y
CONFIG_SYS_MAX_FLASH_SECT=256
CONFIG_SYS_MAX_FLASH_BANKS=2
CONFIG_SYS_MAX_FLASH_BANKS_DETECT=y
#
CONFIG_SYSRESET=y
CONFIG_SYSRESET_CMD_POWEROFF=y
CONFIG_SYSRESET_PSCI=y
#
CONFIG_FIT=y
CONFIG_FIT_SIGNATURE=y
CONFIG_FIT_VERBOSE=y
CONFIG_FIT_BEST_MATCH=y
```

## up/lib/efi_driver/Kconfig
```kconfig
config EFI_GBL_IMAGE_LOADING
	bool "Include GBL Image Loading protocol"
	depends on EFI_LOADER
	help
	  Include the driver for the custom GBL Image Loading protocol.
	  This protocol is used to provide buffers to load different images
	  for verification and boot process.  In addition this protocol
	  provides a list of partitions to be verified before booting.

config EFI_GBL_AB_PROTOCOL
	bool "Include GBL AB boot protocol"
	depends on EFI_LOADER
	select CRC32
	help
	  Include the driver for the custom GBL AB boot slot protocol.
	  This protocol is used for determining the current boot slot,
	  marking boot attempts, changing the currently active slot,
	  and querying metadata about boot slots.

config EFI_GBL_FASTBOOT_PROTOCOL
	bool "Include GBL Fastboot customization protocol"
	depends on EFI_LOADER
	help
	  Include the driver for the custom GBL Fastboot customization protocol.
	  This protocol is used for defining custom fastboot variables,
	  custom oem commands, and driving a device-local bootloader session.

config EFI_GBL_OS_CONFIGURATION_PROTOCOL
	bool "Include GBL Os Configuration protocol"
	depends on EFI_LOADER
	help
	  Include the driver for the custom GBL os configuration protocol.
	  This protocol is used to select base device trees and overlays
	  and apply runtime fix-ups to kernel commandline and bootconfig.
```

## zeus/boards/firefly/roc_rk3588_rt/board.yml
```yaml
board:
  name: roc_rk3588_rt
  full_name: ROC-RK3588-RT (Quad-core Cortex-A55 + Quad-core Cortex-A76)
  vendor: firefly
  socs:
  - name: rk3588
    variants:
    - name: xen_dom0
```

## zeus/boards/radxa/radxa-zero3w/Kconfig.radxa_zero3w
```kconfig
# Copyright 2025 HUSTLER
# SPDX-License-Identifier: Apache-2.0

config BOARD_RADXA_ZERO3W
    select SOC_RK3568
```

## zeus/boards/radxa/radxa-zero3w/board.yml
```yaml
board:
  name: radxa_zero3w
  full_name: radxa_zero3w (Quad-core Cortex-A55)
  vendor: radxa
  socs:
  - name: rk3568
    variants:
    - name: xen_dom0
```

## zeus/boards/radxa/radxa-zero3w/radxa_zero3w_xen_dom0_defconfig
```kconfig
# Copyright 2025 HUSTLER
# SPDX-License-Identifier: Apache-2.0

# Platform Configuration
CONFIG_ARM_ARCH_TIMER=y

# Serial Drivers
CONFIG_SERIAL=y

# Enable console
CONFIG_CONSOLE=y
CONFIG_PRINTK=y
CONFIG_UART_CONSOLE=y
CONFIG_EARLY_CONSOLE=y
CONFIG_STDOUT_CONSOLE=y

# ARMv8 NS world with cache management
CONFIG_ARMV8_A_NS=y
CONFIG_CACHE_MANAGEMENT=y
CONFIG_DCACHE=y

# Clock support
CONFIG_CLOCK_CONTROL=y
CONFIG_TICKLESS_KERNEL=y

CONFIG_SMP=n
CONFIG_MP_MAX_NUM_CPUS=1

# PSCI support
CONFIG_PM_CPU_OPS=y
CONFIG_PM_CPU_OPS_PSCI=y
```

## zeus/soc/rockchip/rk35/rk3588/Kconfig.defconfig
```kconfig
# Copyright 2024 Université Gustave Eiffel
# SPDX-License-Identifier: Apache-2.0

if SOC_RK3588

rsource "Kconfig.defconfig.rk3588"

endif # SOC_RK3588S
```

## zeus/soc/rockchip/rk35/rk3588/Kconfig.soc
```kconfig
# Copyright 2024 Université Gustave Eiffel
# SPDX-License-Identifier: Apache-2.0

config SOC_RK3588
	bool
	select SOC_SERIES_RK35

config SOC
	default "rk3588" if SOC_RK3588
```
