## roux/users/fsutils/mkgpt/Kconfig
```kconfig
#
# For a description of the syntax of this configuration file,
# see the file kconfig-language.txt in the ROUX tools repository.
#

config FSUTILS_MKGPT
	bool "mkgpt utility"
	default n
	select BCH
	select DEV_URANDOM
	---help---
		Enables support for the mkgpt utility
```

## roux/users/graphics/libyuv/Kconfig
```kconfig
#
# For a description of the syntax of this configuration file,
# see the file kconfig-language.txt in the ROUX tools repository.
#

config LIBYUV
	bool "libyuv"
	default n
	---help---
		Enable libyuv.

if LIBYUV

config LIBYUV_BRANCH
	string "libyuv branch (main/stable)"
	default "stable"

endif # LIBYUV
```

## roux/users/system/nsh/Kconfig
```kconfig
#
# For a description of the syntax of this configuration file,
# see the file kconfig-language.txt in the ROUX tools repository.
#

config SYSTEM_NSH
	tristate "NuttShell (NSH) example"
	default n
	select NSH_LIBRARY
	select SYSTEM_READLINE
	---help---
		Enable the NuttShell (NSH) example

if SYSTEM_NSH

config SYSTEM_NSH_PRIORITY
	int "ROUX shell thread priority"
	default 100

config SYSTEM_NSH_STACKSIZE
	int "ROUX shell stack size"
	default DEFAULT_TASK_STACKSIZE

config SYSTEM_NSH_PROGNAME
	string "Program name"
	default "nsh"
	---help---
		This is the name of the program that will be used when the NSH ELF
		program is installed.

endif
```

## roux/users/videoutils/openh264/Kconfig
```kconfig
#
# For a description of the syntax of this configuration file,
# see the file kconfig-language.txt in the ROUX tools repository.
#

config VIDEOUTILS_OPENH264
	bool "Enable openh264"
	default n
```

## up/api/Kconfig
```kconfig
config API
	bool "Enable U-Boot API"
	depends on CC_IS_GCC
	help
	  This option enables the U-Boot API. See api/README for more information.

menu "API"
	depends on API

config SYS_MMC_MAX_DEVICE
	int  "Maximum number of MMC devices exposed via the API"
	default 1

config EXAMPLES
	bool "Compile API examples"
	depends on !SANDBOX
	default y if ARCH_QEMU || ARCH_CRUX
	help
	  U-Boot provides an API for standalone applications. Examples are
	  provided in directory examples/.

config STANDALONE_LOAD_ADDR
	depends on EXAMPLES
	hex "Address in memory to link standalone applications to"
	default 0xffffffff80200000 if MIPS && 64BIT
	default 0x0c100000 if ARM
	default 0x0 if RISCV
	default SYS_LOAD_ADDR
	help
	  This option defines a board specific value for the address where
	  standalone program gets loaded, thus overwriting the architecture
	  dependent default settings.

endmenu
```

## up/arch/arm/mach-imx/imx8m/Kconfig
```kconfig
if ARCH_IMX8M

config IMX8M
	bool
	select BINMAN
	select GICV3 if ARMV8_PSCI
	select HAS_CAAM
	select LTO
	select ROM_UNIFIED_SECTIONS
	select ARMV8_CRYPTO

config IMX8MQ
	bool
	select IMX8M
	select CLK_IMX8MQ

config IMX8MM
	bool
	select IMX8M

config IMX8MN
	bool
	select IMX8M

config IMX8MP
	bool
	select IMX8M

config SYS_SOC
	default "imx8m"

config SYS_HAS_ARMV8_SECURE_BASE
	bool "Enable secure address for PSCI image"
	depends on ARMV8_PSCI
	help
	  PSCI image can be re-located to secure RAM.
	  If enabled, please also define the value for ARMV8_SECURE_BASE,
	  for i.MX8M, it could be some address in OCRAM.

choice
	prompt "NXP i.MX8M board select"
	optional

config TARGET_IMX8MQ_CM
	bool "Ronetix iMX8MQ-CM SoM"
	select IMX8MQ
	select IMX8M_LPDDR4

config TARGET_IMX8MQ_EVK
	bool "imx8mq_evk"
	select IMX8MQ
	select IMX8M_LPDDR4
	select FSL_CAAM
	select ARCH_MISC_INIT
	select SPL_CRYPTO if SPL

config TARGET_IMX8MQ_PHANBELL
	bool "imx8mq_phanbell"
	select IMX8MQ
	select IMX8M_LPDDR4

config TARGET_IMX8MQ_REFORM2
	bool "imx8mq_reform2"
	select IMX8MQ
	select IMX8M_LPDDR4

config TARGET_IMX8MM_DATA_MODUL_EDM_SBC
	bool "Data Modul eDM SBC i.MX8M Mini"
	select IMX8MM
	select IMX8M_LPDDR4
	select SUPPORT_SPL

config TARGET_IMX8MM_EVK
	bool "imx8mm LPDDR4 EVK board"
	select IMX8MM
	select SUPPORT_SPL
	select IMX8M_LPDDR4
	select FSL_CAAM
	select ARCH_MISC_INIT
	select SPL_CRYPTO if SPL

config TARGET_IMX8MM_ICORE_MX8MM
	bool "Engicam i.Core MX8M Mini SOM"
	select IMX8MM
	select SUPPORT_SPL
	select IMX8M_LPDDR4
	help
	  i.Core MX8M Mini is an EDIMM SOM based on NXP i.MX8MM.

	  i.Core MX8M Mini EDIMM2.2:
	  * EDIMM2.2 is a Form Factor Capacitive Evaluation Board.
	  * i.Core MX8M Mini needs to mount on top of EDIMM2.2 for
	    creating complete i.Core MX8M Mini EDIMM2.2 Starter Kit.

	  i.Core MX8M Mini C.TOUCH 2.0
	  * C.TOUCH 2.0 is a general purpose Carrier board.
	  * i.Core MX8M Mini needs to mount on top of this Carrier board
	    for creating complete i.Core MX8M Mini C.TOUCH 2.0 board.

config TARGET_IMX8MM_MX8MENLO
	bool "Support i.MX8M Mini MX8Menlo board based on Toradex Verdin SoM"
	select IMX8MM
	select SUPPORT_SPL
	select IMX8M_LPDDR4

config TARGET_IMX8MM_PHG
	bool "i.MX8MM PHG board"
	select IMX8MM
	select SUPPORT_SPL
	select IMX8M_LPDDR4

config TARGET_IMX8MM_VENICE
	bool "Support Gateworks Venice iMX8M Mini module"
	select IMX8MM
	select SUPPORT_SPL
	select IMX8M_LPDDR4
	select GATEWORKS_SC
	select MISC
	select FSL_CAAM
	select ARCH_MISC_INIT
	select SPL_CRYPTO if SPL

config TARGET_KONTRON_MX8MM
	bool "Kontron Electronics N80xx"
	select IMX8MM
	select SUPPORT_SPL
	select IMX8M_LPDDR4
	select FSL_CAAM
	select ARCH_MISC_INIT
	select SPL_CRYPTO if SPL

config TARGET_IMX8MN_BSH_SMM_S2
	bool "imx8mn-bsh-smm-s2"
	select IMX8MN
	select SUPPORT_SPL
	select IMX8M_DDR3L

config TARGET_IMX8MN_BSH_SMM_S2PRO
	bool "imx8mn-bsh-smm-s2pro"
	select IMX8MN
	select SUPPORT_SPL
	select IMX8M_DDR3L

config TARGET_IMX8MN_EVK
	bool "imx8mn LPDDR4 EVK board"
	select IMX8MN
	select SUPPORT_SPL
	select IMX8M_LPDDR4
	select FSL_CAAM
	select SPL_CRYPTO if SPL

config TARGET_IMX8MN_DDR4_EVK
	bool "imx8mn DDR4 EVK board"
	select IMX8MN
	select SUPPORT_SPL
	select IMX8M_DDR4
	select FSL_CAAM
	select SPL_CRYPTO if SPL

config TARGET_IMX8MN_VENICE
	bool "Support Gateworks Venice iMX8M Nano module"
	select IMX8MN
	select SUPPORT_SPL
	select IMX8M_LPDDR4
	select GATEWORKS_SC
	select MISC
	select FSL_CAAM
	select ARCH_MISC_INIT
	select SPL_CRYPTO if SPL

config TARGET_IMX8MP_DATA_MODUL_EDM_SBC
	bool "Data Modul eDM SBC i.MX8M Plus"
	select IMX8MP
	select IMX8M_LPDDR4
	select SUPPORT_SPL

config TARGET_IMX8MP_BEACON
	bool "imx8mm Beacon Embedded devkit"
	select IMX8MP
	select SUPPORT_SPL
	select IMX8M_LPDDR4
	select FSL_CAAM
	select ARCH_MISC_INIT
	select SPL_CRYPTO if SPL

config TARGET_IMX8MP_DEBIX_MODEL_A
	bool "Polyhex i.MX8M Plus Debix Model A SBC"
	select IMX8MP
	select IMX8M_LPDDR4
	select SUPPORT_SPL

config TARGET_IMX8MP_DH_DHCOM_PDK2
	bool "DH electronics DHCOM Premium Developer Kit (2) i.MX8M Plus"
	select IMX8MP
	select IMX8M_LPDDR4
	select SUPPORT_SPL

config TARGET_IMX8MP_ICORE_MX8MP
	bool "Engicam i.Core MX8M Plus SOM"
	select IMX8MP
	select IMX8M_LPDDR4
	select SUPPORT_SPL
	help
	  i.Core MX8M Plus is an EDIMM SOM based on NXP i.MX8MP.

	  i.Core MX8M Plus EDIMM2.2:
	  * EDIMM2.2 is a Form Factor Capacitive Evaluation Board.
	  * i.Core MX8M Plus needs to mount on top of EDIMM2.2 for
	    creating complete i.Core MX8M Plus EDIMM2.2 Starter Kit.

config TARGET_IMX8MP_EVK
	bool "imx8mp LPDDR4 EVK board"
	select IMX8MP
	select SUPPORT_SPL
	select IMX8M_LPDDR4
	select FSL_CAAM
	select ARCH_MISC_INIT
	select SPL_CRYPTO if SPL

config TARGET_IMX8MP_VENICE
	bool "Support Gateworks Venice iMX8M Plus module"
	select IMX8MP
	select SUPPORT_SPL
	select IMX8M_LPDDR4
	select GATEWORKS_SC
	select MISC
	select FSL_CAAM
	select ARCH_MISC_INIT
	select SPL_CRYPTO if SPL

config TARGET_PICO_IMX8MQ
	bool "Support Technexion Pico iMX8MQ"
	select IMX8MQ
	select IMX8M_LPDDR4

config TARGET_IMX8MN_VAR_SOM
	bool "Variscite imx8mn_var_som"
	select IMX8MN
	select SUPPORT_SPL
	select IMX8M_DDR4
	select MISC
	select I2C_EEPROM
	select DM_ETH_PHY
	select NVMEM

config TARGET_KONTRON_PITX_IMX8M
	bool "Support Kontron pITX-imx8m"
	select IMX8MQ
	select IMX8M_LPDDR4

config TARGET_VERDIN_IMX8MM
	bool "Support Toradex Verdin iMX8M Mini module"
	select IMX8MM
	select SUPPORT_SPL
	select IMX8M_LPDDR4

config TARGET_VERDIN_IMX8MP
	bool "Support Toradex Verdin iMX8M Plus module"
	select IMX8MP
	select SUPPORT_SPL
	select IMX8M_LPDDR4

config TARGET_IMX8MM_BEACON
	bool "imx8mm Beacon Embedded devkit"
	select IMX8MM
	select SUPPORT_SPL
	select IMX8M_LPDDR4
	select FSL_CAAM
	select ARCH_MISC_INIT
	select SPL_CRYPTO if SPL

config TARGET_IMX8MN_BEACON
	bool "imx8mn Beacon Embedded devkit"
	select IMX8MN
	select SUPPORT_SPL
	select IMX8M_LPDDR4
	select FSL_CAAM
	select ARCH_MISC_INIT
	select SPL_CRYPTO if SPL

config TARGET_PHYCORE_IMX8MM
	bool "PHYTEC PHYCORE i.MX8MM"
	select IMX8MM
	select SUPPORT_SPL
	select IMX8M_LPDDR4

config TARGET_PHYCORE_IMX8MP
	bool "PHYTEC PHYCORE i.MX8MP"
	select IMX8MP
	select SUPPORT_SPL
	select IMX8M_LPDDR4

config TARGET_IMX8MM_CL_IOT_GATE
	bool "CompuLab iot-gate-imx8"
	select IMX8MM
	select SUPPORT_SPL
	select IMX8M_LPDDR4
	select SUPPORT_EXTENSION_SCAN

config TARGET_IMX8MM_CL_IOT_GATE_OPTEE
	bool "CompuLab iot-gate-imx8 with optee support"
	select IMX8MM
	select SUPPORT_SPL
	select IMX8M_LPDDR4
	select SUPPORT_EXTENSION_SCAN

config TARGET_IMX8MP_RSB3720A1_4G
	bool "Support i.MX8MP RSB3720A1 4G"
	select IMX8MP
	select SUPPORT_SPL
	select IMX8M_LPDDR4

config TARGET_IMX8MP_RSB3720A1_6G
	bool "Support i.MX8MP RSB3720A1 6G"
	select IMX8MP
	select SUPPORT_SPL
	select IMX8M_LPDDR4

config TARGET_MSC_SM2S_IMX8MP
	bool "MSC SMARC2 i.MX8MPLUS"
	select IMX8MP
	select SUPPORT_SPL
	select IMX8M_LPDDR4

config TARGET_LIBREM5
	bool "Purism Librem5 Phone"
	select IMX8MQ
	select SUPPORT_SPL
	select IMX8M_LPDDR4

endchoice

source "board/google/imx8mq_phanbell/Kconfig"

endif
```

## up/arch/arm/mach-qemu/Kconfig
```kconfig
if ARCH_QEMU

config SYS_VENDOR
	default "emulation"

config SYS_BOARD
	default "qemu-arm"

config SYS_CONFIG_NAME
	default "qemu-arm"

config SYS_SDRAM_BASE
	hex "SDRAM base address"
	default 0x40000000
	help
	  The address that is start of SDRAM.

config SYS_FDT_ADDR
	hex "FDT load address"
	default 0x40000000
	help
	  The default FDT load address.

config SYS_RAMDISK_ADDR_R
	hex "Ramdisk load address"
	default 0x44200000
	help
	  The default initramfs load address.

config SYS_SCRIPT_ADDR
	hex "Script load address"
	default 0x44300000
	help
	  The default script load address.

config SYS_PXEFILE_ADDR_R
	hex "PXEfile load address"
	default 0x44400000
	help
	  The default PXEfile load address.

choice
	prompt "QEMU ARM architecture"
	default TARGET_QEMU_ARM_64BIT

config TARGET_QEMU_ARM_32BIT
	bool "ARMv7-A, 32bit"
	select ARCH_SUPPORT_PSCI
	select BOARD_LATE_INIT
	select CPU_V7A
	select SYS_ARCH_TIMER

config TARGET_QEMU_ARM_64BIT
	bool "ARMv8, 64bit"
	select ARM64
	select BOARD_LATE_INIT

endchoice

endif
```

## up/board/armltd/vexpress64/Kconfig
```kconfig
if ARCH_VEXPRESS64

config SYS_BOARD
	default "vexpress64"

config SYS_VENDOR
	default "armltd"

config SYS_CONFIG_NAME
	default "vexpress_aemv8"

config VEXPRESS64_BASE_MODEL
	bool
	select SEMIHOSTING
	imply VIRTIO_MMIO
	select VIRTIO_BLK if VIRTIO_MMIO
	select VIRTIO_NET if VIRTIO_MMIO
	select DM_ETH if VIRTIO_NET
	imply RTC_PL031
	select DM_RTC if RTC_PL031
	imply EFI_SET_TIME if DM_RTC
	select LINUX_KERNEL_IMAGE_HEADER
	select POSITION_INDEPENDENT

choice
	prompt "VExpress64 board variant"

config TARGET_VEXPRESS64_BASE_FVP
	bool "Support Versatile Express ARMv8a FVP BASE model"
	select VEXPRESS64_BASE_MODEL
	imply OF_HAS_PRIOR_STAGE

config TARGET_VEXPRESS64_BASER_FVP
	bool "Support Versatile Express ARMv8r64 FVP BASE model"
	select VEXPRESS64_BASE_MODEL
	imply OF_HAS_PRIOR_STAGE
	select LINUX_KERNEL_IMAGE_HEADER

config TARGET_VEXPRESS64_GEM5
	bool "Support Versatile Express gem5 (vexpress_gem5) model"
	select VEXPRESS64_BASE_MODEL
	select OF_BOARD
	select VIRTIO_PCI
	select VIRTIO_PCI_LEGACY
	imply BOARD_LATE_INIT
	imply CMD_DM

config TARGET_VEXPRESS64_JUNO
	bool "Support Versatile Express Juno Development Platform"
	select PCIE_ECAM_GENERIC if PCI
	select SATA_SIL
	select SMC911X if DM_ETH
	select SMC911X_32_BIT if SMC911X
	select CMD_USB if USB
	select USB_EHCI_HCD if USB
	select USB_EHCI_GENERIC if USB
	select USB_OHCI_HCD if USB
	select USB_OHCI_GENERIC if USB
	imply OF_HAS_PRIOR_STAGE

endchoice

config JUNO_DTB_PART
	string "NOR flash partition holding DTB"
	default "board.dtb"
	help
	  The ARM partition name in the NOR flash memory holding the
	  device tree blob to configure U-Boot.

config LNX_KRNL_IMG_TEXT_OFFSET_BASE
	default TEXT_BASE

config TEXT_BASE
	default 0x88000000 if TARGET_VEXPRESS64_BASE_FVP
	default 0xe0000000 if TARGET_VEXPRESS64_JUNO
	default 0x00001000 if TARGET_VEXPRESS64_BASER_FVP
	# gem5 really needs 0x10, but this is handled in the linker script
	# because TEXT_BASE is required to be page aligned
	default 0x00000000 if TARGET_VEXPRESS64_GEM5

config SYS_MALLOC_LEN
	default 0x810000 if TARGET_VEXPRESS64_JUNO
	default 0x840000 if TARGET_VEXPRESS64_BASE_FVP

config SYS_MALLOC_F_LEN
	default 0x2000

config SYS_LOAD_ADDR
	default 0x10000000 if TARGET_VEXPRESS64_BASER_FVP
	default 0x80200000 if TARGET_VEXPRESS64_GEM5
	default 0x90000000

if TARGET_VEXPRESS64_GEM5

config SYS_EARLY_PCI_INIT
	def_bool y

config SYS_FDT_ADDR
	hex "FDT load address"
	default 0x88000000
	help
	  On vexpress_gem5, the physical address of a preloaded device
          tree blob to configure U-Boot.

endif # TARGET_VEXPRESS64_GEM5

if TARGET_VEXPRESS64_JUNO

config JUNO_DTB_PART
	string "NOR flash partition holding DTB"
	default "board.dtb"
	help
	  The ARM partition name in the NOR flash memory holding the
	  device tree blob to configure U-Boot.

config LNX_KRNL_IMG_TEXT_OFFSET_BASE
	default TEXT_BASE

config ENV_ADDR
	default 0x0BFC0000 if TARGET_VEXPRESS64_JUNO
	default 0x0FFC0000 if TARGET_VEXPRESS64_BASE_FVP
	default 0x8FFC0000 if TARGET_VEXPRESS64_BASER_FVP

config ENV_SIZE
	default 0x10000 if TARGET_VEXPRESS64_JUNO
	default 0x40000

config ENV_SECT_SIZE
	default 0x10000 if TARGET_VEXPRESS64_JUNO
	default 0x40000

endif # TARGET_VEXPRESS64_JUNO

endif
```

## up/board/emulation/Kconfig
```kconfig
# SPDX-License-Identifier: GPL-2.0+
#
# Copyright (C) 2015, Bin Meng <bmeng.cn@gmail.com>

if VENDOR_EMULATION

choice
	prompt "Mainboard model"

endchoice

endif
```

## up/board/xen/xenguest_arm64_dom0less/Kconfig
```kconfig
if TARGET_XENGUEST_ARM64_DOM0LESS

config SYS_BOARD
	default "xenguest_arm64_dom0less"

config SYS_VENDOR
	default "xen"

config SYS_CONFIG_NAME
	default "xenguest_arm64_dom0less"

config SYS_SDRAM_BASE
	hex "SDRAM base address"
	default 0x40000000
	help
	  The address that is start of SDRAM.

config SYS_FDT_ADDR
	hex "FDT load address"
	default 0x40000000
	help
	  The default FDT load address.

config SYS_RAMDISK_ADDR_R
	hex "Ramdisk load address"
	default 0x44200000
	help
	  The default initramfs load address.

config SYS_SCRIPT_ADDR
	hex "Script load address"
	default 0x44300000
	help
	  The default script load address.

config SYS_PXEFILE_ADDR_R
	hex "PXEfile load address"
	default 0x44400000
	help
	  The default PXEfile load address.

# XEN
config LNX_KRNL_IMG_TEXT_OFFSET_BASE
	default SYS_LOAD_ADDR

endif
```
